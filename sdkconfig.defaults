## sdkconfig.defaults
```kconfig
# Rust main task needs a bigger stack than the default.
CONFIG_ESP_MAIN_TASK_STACK_SIZE=32000

# 8MB Octal PSRAM on the ESP32-S3-PICO-1-N8R8 (used for audio buffers).
CONFIG_SPIRAM=y
CONFIG_SPIRAM_MODE_OCT=y
CONFIG_SPIRAM_SPEED_80M=y
CONFIG_SPIRAM_USE_MALLOC=y

# 1kHz tick gives finer-grained I2S / socket timeouts.
CONFIG_FREERTOS_HZ=1000

# Phone browsers send large request headers on the provisioning POST; the
# default 512 is too small ("Header fields are too long").
CONFIG_HTTPD_MAX_REQ_HDR_LEN=2048

# Keep logs readable over the USB serial monitor.
CONFIG_LOG_DEFAULT_LEVEL_INFO=y

# ESP-SR dual wake word: the "Sophia" + "Jarvis" WakeNet9 models, read from the
# flash "model" partition. Both pack into srmodels.bin; the AFE runs both and
# reports which one fired. Needs PSRAM (above) and a custom partition table.
CONFIG_SR_WN_WN9_SOPHIA_TTS=y
CONFIG_SR_WN_WN9_JARVIS_TTS=y
CONFIG_MODEL_IN_FLASH=y
CONFIG_ESP_DEFAULT_CPU_FREQ_MHZ_240=y

# 8MB flash (the model + app + nvs partitions overflow the default 2MB).
CONFIG_ESPTOOLPY_FLASHSIZE_8MB=y

# Custom partition table that adds the speech-model partition. Absolute path:
# ESP-IDF resolves this relative to the (generated) build dir, not our crate.
CONFIG_PARTITION_TABLE_CUSTOM=y
CONFIG_PARTITION_TABLE_CUSTOM_FILENAME="C:/Users/gravi/Documents/rust/ATOMVoiceS3R/partitions.csv"
```
